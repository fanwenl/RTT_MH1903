## Kconfig
```kconfig
mainmenu "RT-Thread Configuration"

config BSP_DIR
    string
    option env="BSP_ROOT"
    default "."

config RTT_DIR
    string
    option env="RTT_ROOT"
    default "rt-thread"

config PKGS_DIR
    string
    option env="PKGS_ROOT"
    default "packages"

source "$RTT_DIR/Kconfig"
source "$PKGS_DIR/Kconfig"
#source "libraries/Kconfig"
source "board/Kconfig"

config SOC_MH190X
    bool
    select RT_USING_COMPONENTS_INIT
    select RT_USING_USER_MAIN
    default y
```

## board/Kconfig
```kconfig
menu "Hardware Drivers Config"

    config BSP_USING_ON_CHIP_FLASH
        bool "Enable on-chip FLASH"
        default n

    config BSP_USING_GPIO
        bool "Enable GPIO"
        select RT_USING_PIN
        default y

    menuconfig BSP_USING_UART
        bool "Enable UART"
        default y
        select RT_USING_SERIAL
        if BSP_USING_UART
            config BSP_USING_UART0
                bool "Enable UART0"
                default y

            config BSP_USING_UART1
                bool "Enable UART1"
                default n

            config BSP_USING_UART2
                bool "Enable UART2"
                default n

            config BSP_USING_UART3
                bool "Enable UART3"
                default n
        endif

    config BSP_USING_ONCHIP_RTC
        bool "Enable RTC"
        select RT_USING_RTC
        default n

    config BSP_USING_WDT
        bool "Enable Watchdog Timer"
        select RT_USING_WDT
        default n

    menuconfig BSP_USING_PWM
        bool "Enable pwm"
        default n
        select RT_USING_PWM

        if BSP_USING_PWM
            config BSP_USING_PWM0
            bool "Enable PWM0"
            default n

            config BSP_USING_PWM1
            bool "Enable PWM1"
            default n

            config BSP_USING_PWM2
            bool "Enable PWM2"
            default n

            config BSP_USING_PWM3
            bool "Enable PWM3"
            default n

            config BSP_USING_PWM4
            bool "Enable PWM4"
            default n

            config BSP_USING_PWM5
            bool "Enable PWM5"
            default n

            config BSP_USING_PWM6
            bool "Enable PWM6"
            default n

            config BSP_USING_PWM7
            bool "Enable PWM7"
            default n

        endif

endmenu
```
